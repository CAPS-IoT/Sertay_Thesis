## SIF_wasm_dht/main/Kconfig.projbuild
```kconfig
menu "SIF Wasm DHT — Migration Config"

    config WIFI_SSID
        string "WiFi SSID"
        default "myssid"
        help
            SSID of the WiFi network the ESP32 will connect to.

    config WIFI_PASS
        string "WiFi Password"
        default ""
        help
            Password of the WiFi network. Leave empty for an open network.

    config MQTT_BROKER
        string "MQTT broker hostname"
        default "mqtt.caps-platform.de"

    config MQTT_USER
        string "MQTT username"
        default "JWT"

    config MQTT_TOKEN
        string "MQTT password / JWT token"
        default ""
        help
            JWT token used as MQTT password (caps-platform.de uses JWT auth).

    config CAPS_USER_ID
        int "CAPS platform user ID"
        default 64

    config CAPS_DEVICE_ID
        int "CAPS platform device ID"
        default 199

    config DATA_TOPIC
        string "MQTT data topic (<userID>/<deviceID>/data)"
        default "64/199/data"
        help
            The CAPS platform only allows publishing/subscribing to
            <userID>/<deviceID>/data.  All offload and control
            messages go through this single topic.

    config EDGE_HOST_URL
        string "Edge host URL for HTTP offload"
        default "http://192.168.178.86:8080/process"
        help
            Full URL of the sif-edge-host /process endpoint.
            The ESP32 POSTs sensor events here when in edge mode.
            Format: http://<node-ip>:<nodeport>/process

    config BATTERY_THRESHOLD
        int "Battery SoC threshold for offloading (%)"
        default 200
        help
            When battery state-of-charge falls below this percentage,
            execution is offloaded to the Edge via HTTP.
            Set above 100 to always offload (useful for testing).

    config ACTUATOR_LED_GREEN_GPIO
        int "GPIO for Wasm actuator green LED (-1 disables)"
        range -1 39
        default 17
        help
            GPIO driven when Wasm actuatorCommand is 1. Set to -1 to disable
            the physical green LED actuator output.

    config ACTUATOR_LED_RED_GPIO
        int "GPIO for Wasm actuator red LED (-1 disables)"
        range -1 39
        default 16
        help
            GPIO driven when Wasm actuatorCommand is 2. Set to -1 to disable
            the physical red LED actuator output.

    config DEADLINE_LED_BLUE_GPIO
        int "GPIO for deadline rejection blue LED (-1 disables)"
        range -1 39
        default 18
        help
            GPIO used for the temporary two-blink deadline rejection signal.

    config ACTUATOR_LED_ACTIVE_LOW
        bool "Wasm actuator LEDs are active-low"
        default y
        help
            Enable for the test-board common-anode RGB LED, whose channels turn
            on when their GPIO is driven low.

    config LED_BOOT_DIAGNOSTIC
        bool "Run labeled RGB channel diagnostic at boot"
        default y
        help
            Drive green, red, and blue individually for 500 ms each, with all
            other channels forced off, then leave the RGB LED fully off. The
            serial labels make the physical GPIO-to-color mapping unambiguous.

endmenu
```

## SIF_wasm_dht/sdkconfig.defaults
```kconfig
# Enable RTTI (required by SIF framework - uses dynamic_cast extensively)
CONFIG_COMPILER_CXX_RTTI=y

# Enable C++ exceptions (required by sif_energy_manager, BNO055, etc.)
CONFIG_COMPILER_CXX_EXCEPTIONS=y

# Custom partition table — firmware (~1.1 MB) exceeds default 1 MB factory.
CONFIG_PARTITION_TABLE_CUSTOM=y
CONFIG_PARTITION_TABLE_CUSTOM_FILENAME="partitions.csv"
CONFIG_PARTITION_TABLE_FILENAME="partitions.csv"

# 4 MB flash on EzSBC ESP32-Bat (ESP32-WROOM-32E)
CONFIG_ESPTOOLPY_FLASHSIZE_4MB=y
CONFIG_ESPTOOLPY_FLASHSIZE="4MB"

# Brownout detector — enabled now that Li-Po battery is connected.
CONFIG_ESP_BROWNOUT_DET=y

# Lower WiFi TX power to reduce current spikes (max = 78 quarter-dBm = 19.5 dBm).
# 34 ≈ 8.5 dBm — enough for nearby AP, much gentler on 3V3.
CONFIG_ESP_PHY_MAX_WIFI_TX_POWER=10
CONFIG_ESP_PHY_REDUCE_TX_POWER=y

# Keep Wi-Fi's dynamic buffer footprint small while the network control plane
# and the statically reserved WAMR memory coexist.
CONFIG_ESP_WIFI_STATIC_RX_BUFFER_NUM=4
CONFIG_ESP_WIFI_DYNAMIC_RX_BUFFER_NUM=8
CONFIG_ESP_WIFI_DYNAMIC_TX_BUFFER_NUM=8
CONFIG_ESP_WIFI_RX_BA_WIN=2
CONFIG_ESP_WIFI_MGMT_SBUF_NUM=6

# The firmware uses plain MQTT over TCP. Disable unused transports and keep the
# MQTT task small enough for local-mode control traffic.
CONFIG_MQTT_USE_CUSTOM_CONFIG=y
CONFIG_MQTT_TASK_STACK_SIZE=4096
# CONFIG_MQTT_TRANSPORT_SSL is not set
# CONFIG_MQTT_TRANSPORT_WEBSOCKET is not set
# CONFIG_MQTT_TRANSPORT_WEBSOCKET_SECURE is not set

# WAMR Configuration - disable features not needed/supported on ESP32
CONFIG_WAMR_ENABLE_INTERP=y
CONFIG_WAMR_INTERP_FAST=y
CONFIG_WAMR_ENABLE_AOT=n
CONFIG_WAMR_ENABLE_LIBC_BUILTIN=y
CONFIG_WAMR_ENABLE_LIBC_WASI=n
CONFIG_WAMR_ENABLE_LIB_PTHREAD=n
CONFIG_WAMR_ENABLE_SHARED_MEMORY=n
CONFIG_WAMR_ENABLE_MULTI_MODULE=n
CONFIG_WAMR_ENABLE_MEMORY_PROFILING=n
CONFIG_WAMR_ENABLE_PERF_PROFILING=n
CONFIG_WAMR_ENABLE_REF_TYPES=n

# Enable I2C bus 0 for MAX17048 battery fuel gauge
# EzSBC ESP32-Bat: SDA=21, SCL=22 (defaults)
CONFIG_I2C_0_ENABLED=y
CONFIG_I2C_0_SDA_PIN=21
CONFIG_I2C_0_SCL_PIN=22
CONFIG_I2C_0_MASTER=y

# Re-enable brownout detector now that we have a battery
CONFIG_ESP_BROWNOUT_DET=y

# Physically verified common-anode RGB LED used by the actuator/deadline demo.
CONFIG_ACTUATOR_LED_GREEN_GPIO=17
CONFIG_ACTUATOR_LED_RED_GPIO=16
CONFIG_DEADLINE_LED_BLUE_GPIO=18
CONFIG_ACTUATOR_LED_ACTIVE_LOW=y
CONFIG_LED_BOOT_DIAGNOSTIC=y
```
